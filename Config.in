## Config.in
```kconfig
source "$BR2_EXTERNAL_BLACKHAT_PATH/package/blackhat/Config.in"
source "$BR2_EXTERNAL_BLACKHAT_PATH/package/python-routersploit/Config.in"
source "$BR2_EXTERNAL_BLACKHAT_PATH/package/python-pycryptodome/Config.in"
source "$BR2_EXTERNAL_BLACKHAT_PATH/package/python-nmap/Config.in"
source "$BR2_EXTERNAL_BLACKHAT_PATH/package/python-pywifi/Config.in"
source "$BR2_EXTERNAL_BLACKHAT_PATH/package/bjorn/Config.in"
source "$BR2_EXTERNAL_BLACKHAT_PATH/package/python-pandas/Config.in"
source "$BR2_EXTERNAL_BLACKHAT_PATH/package/python-getmac/Config.in"
source "$BR2_EXTERNAL_BLACKHAT_PATH/package/python-rich/Config.in"
source "$BR2_EXTERNAL_BLACKHAT_PATH/package/python-wifite2/Config.in"
source "$BR2_EXTERNAL_BLACKHAT_PATH/package/python-version/Config.in"
```

## configs/flipper_blackhat_a33_defconfig
```kconfig
BR2_arm=y
BR2_cortex_a7=y
BR2_PACKAGE_HOST_LINUX_HEADERS_CUSTOM_6_14=y
BR2_BINUTILS_VERSION_2_42_X=y
BR2_TOOLCHAIN_BUILDROOT_CXX=y
BR2_CURL="curl -q --ftp-pasv --retry 3"
BR2_WGET="wget -nd -t 3"
BR2_SVN="svn --non-interactive"
BR2_SCP="scp"
BR2_SFTP="sftp"
BR2_GLOBAL_PATCH_DIR="$(BR2_EXTERNAL_BLACKHAT_PATH)/patches/global/"
BR2_TARGET_GENERIC_HOSTNAME="flipper-blackhat"
BR2_TARGET_GENERIC_ISSUE="Welcome to the Flipper Blackhat"
BR2_ROOTFS_DEVICE_CREATION_DYNAMIC_EUDEV=y
BR2_ROOTFS_MERGED_USR=y
BR2_TARGET_GENERIC_ROOT_PASSWD="blackhat"
BR2_TARGET_GENERIC_GETTY_PORT="ttyS0"
BR2_SYSTEM_DEFAULT_PATH="/bin:/sbin:/usr/bin:/usr/sbin"
BR2_TARGET_TZ_INFO=y
BR2_ROOTFS_OVERLAY="$(BR2_EXTERNAL_BLACKHAT_PATH)/rootfs_overlay/"
BR2_ROOTFS_POST_BUILD_SCRIPT="$(BR2_EXTERNAL_BLACKHAT_PATH)/genimage/post-build.sh"
BR2_ROOTFS_POST_IMAGE_SCRIPT="support/scripts/genimage.sh"
BR2_ROOTFS_POST_SCRIPT_ARGS="-c $(BR2_EXTERNAL_BLACKHAT_PATH)/genimage/genimage.cfg"
BR2_LINUX_KERNEL=y
BR2_LINUX_KERNEL_CUSTOM_GIT=y
BR2_LINUX_KERNEL_CUSTOM_REPO_URL="git://git.kernel.org/pub/scm/linux/kernel/git/torvalds/linux.git"
BR2_LINUX_KERNEL_CUSTOM_REPO_VERSION="v6.15"
BR2_LINUX_KERNEL_PATCH="$(BR2_EXTERNAL_BLACKHAT_PATH)/patches/linux/"
BR2_LINUX_KERNEL_USE_CUSTOM_CONFIG=y
BR2_LINUX_KERNEL_CUSTOM_CONFIG_FILE="$(BR2_EXTERNAL_BLACKHAT_PATH)/configs/linux_flipper_a33_defconfig"
BR2_LINUX_KERNEL_DTS_SUPPORT=y
BR2_LINUX_KERNEL_CUSTOM_DTS_PATH="$(BR2_EXTERNAL_BLACKHAT_PATH)/board/flipper-blackhat-a33.dts"
BR2_LINUX_KERNEL_INSTALL_TARGET=y
BR2_PACKAGE_BUSYBOX_CONFIG="$(BR2_EXTERNAL_BLACKHAT_PATH)/configs/busybox.config"
BR2_PACKAGE_BUSYBOX_SHOW_OTHERS=y
BR2_PACKAGE_BINUTILS=y
BR2_PACKAGE_DOS2UNIX=y
BR2_PACKAGE_GAWK=y
BR2_PACKAGE_GIT=y
BR2_PACKAGE_GPERF=y
BR2_PACKAGE_GREP=y
BR2_PACKAGE_MAKE=y
BR2_PACKAGE_PATCH=y
BR2_PACKAGE_SED=y
BR2_PACKAGE_E2FSPROGS=y
BR2_PACKAGE_E2FSPROGS_RESIZE2FS=y
BR2_PACKAGE_CHOCOLATE_DOOM=y
BR2_PACKAGE_DOOM_WAD=y
BR2_PACKAGE_FBSET=y
BR2_PACKAGE_MESA3D=y
BR2_PACKAGE_MESA3D_GALLIUM_DRIVER_LIMA=y
BR2_PACKAGE_MESA3D_OPENGL_EGL=y
BR2_PACKAGE_MESA3D_OPENGL_ES=y
BR2_PACKAGE_SDL2_KMSDRM=y
BR2_PACKAGE_SDL2_OPENGLES=y
BR2_PACKAGE_LINUX_FIRMWARE=y
BR2_PACKAGE_LINUX_FIRMWARE_RTL_87XX=y
BR2_PACKAGE_LINUX_FIRMWARE_RTL_RTW88=y
BR2_PACKAGE_GPSD=y
BR2_PACKAGE_GPSD_ASHTECH=y
BR2_PACKAGE_GPSD_EARTHMATE=y
BR2_PACKAGE_GPSD_EVERMORE=y
BR2_PACKAGE_GPSD_FURY=y
BR2_PACKAGE_GPSD_FV18=y
BR2_PACKAGE_GPSD_GARMIN=y
BR2_PACKAGE_GPSD_GARMIN_SIMPLE_TXT=y
BR2_PACKAGE_GPSD_GEOSTAR=y
BR2_PACKAGE_GPSD_GPSCLOCK=y
BR2_PACKAGE_GPSD_GREIS=y
BR2_PACKAGE_GPSD_ISYNC=y
BR2_PACKAGE_GPSD_ITRAX=y
BR2_PACKAGE_GPSD_NMEA2000=y
BR2_PACKAGE_GPSD_OCEANSERVER=y
BR2_PACKAGE_GPSD_ONCORE=y
BR2_PACKAGE_GPSD_RTCM104V2=y
BR2_PACKAGE_GPSD_RTCM104V3=y
BR2_PACKAGE_GPSD_SIRF=y
BR2_PACKAGE_GPSD_SKYTRAQ=y
BR2_PACKAGE_GPSD_SUPERSTAR2=y
BR2_PACKAGE_GPSD_TRIMBLE_TSIP=y
BR2_PACKAGE_GPSD_TRIPMATE=y
BR2_PACKAGE_GPSD_TRUE_NORTH=y
BR2_PACKAGE_GPSD_UBX=y
BR2_PACKAGE_KBD=y
BR2_PACKAGE_USB_MODESWITCH_DATA=y
BR2_PACKAGE_PYTHON3=y
BR2_PACKAGE_PYTHON3_2TO3=y
BR2_PACKAGE_PYTHON3_BERKELEYDB=y
BR2_PACKAGE_PYTHON3_BZIP2=y
BR2_PACKAGE_PYTHON3_CODECSCJK=y
BR2_PACKAGE_PYTHON3_CURSES=y
BR2_PACKAGE_PYTHON3_DECIMAL=y
BR2_PACKAGE_PYTHON3_OSSAUDIODEV=y
BR2_PACKAGE_PYTHON3_READLINE=y
BR2_PACKAGE_PYTHON3_SQLITE=y
BR2_PACKAGE_PYTHON3_XZ=y
BR2_PACKAGE_PYTHON_FLASK=y
BR2_PACKAGE_PYTHON_PIP=y
BR2_PACKAGE_LIBDRM_INSTALL_TESTS=y
BR2_PACKAGE_TIFF=y
BR2_PACKAGE_WEBP=y
BR2_PACKAGE_LIBCURL=y
BR2_PACKAGE_LIBCURL_CURL=y
BR2_PACKAGE_LIBMICROHTTPD=y
BR2_PACKAGE_LIBMICROHTTPD_SSL=y
BR2_PACKAGE_APR_UTIL=y
BR2_PACKAGE_LIBCAP=y
BR2_PACKAGE_GNURADIO=y
BR2_PACKAGE_GR_OSMOSDR=y
BR2_PACKAGE_GR_OSMOSDR_RTLSDR=y
BR2_PACKAGE_GR_OSMOSDR_RTLSDR_TCP=y
BR2_PACKAGE_GR_OSMOSDR_HACKRF=y
BR2_PACKAGE_AIRCRACK_NG=y
BR2_PACKAGE_BRIDGE_UTILS=y
BR2_PACKAGE_CRDA=y
BR2_PACKAGE_DHCPCD=y
BR2_PACKAGE_DNSMASQ=y
BR2_PACKAGE_DNSMASQ_DNSSEC=y
BR2_PACKAGE_DNSMASQ_IDN=y
BR2_PACKAGE_DNSMASQ_CONNTRACK=y
BR2_PACKAGE_DROPBEAR=y
# BR2_PACKAGE_DROPBEAR_SMALL is not set
BR2_PACKAGE_ETHTOOL=y
BR2_PACKAGE_HOSTAPD=y
BR2_PACKAGE_IPSET=y
BR2_PACKAGE_IPTABLES=y
BR2_PACKAGE_IPTABLES_NFTABLES=y
BR2_PACKAGE_IW=y
BR2_PACKAGE_IWD=y
BR2_PACKAGE_KISMET=y
BR2_PACKAGE_LINKS=y
BR2_PACKAGE_LINUX_ZIGBEE=y
BR2_PACKAGE_NFTABLES=y
BR2_PACKAGE_NGINX=y
BR2_PACKAGE_NGINX_FILE_AIO=y
BR2_PACKAGE_NGINX_THREADS=y
BR2_PACKAGE_NGINX_HTTP_CACHE=y
BR2_PACKAGE_NGINX_HTTP_SSL_MODULE=y
BR2_PACKAGE_NGINX_HTTP_V2_MODULE=y
BR2_PACKAGE_NGINX_HTTP_REALIP_MODULE=y
BR2_PACKAGE_NGINX_HTTP_ADDITION_MODULE=y
BR2_PACKAGE_NGINX_HTTP_XSLT_MODULE=y
BR2_PACKAGE_NGINX_HTTP_IMAGE_FILTER_MODULE=y
BR2_PACKAGE_NGINX_HTTP_GEOIP_MODULE=y
BR2_PACKAGE_NGINX_HTTP_SUB_MODULE=y
BR2_PACKAGE_NGINX_HTTP_DAV_MODULE=y
BR2_PACKAGE_NGINX_HTTP_FLV_MODULE=y
BR2_PACKAGE_NGINX_HTTP_MP4_MODULE=y
BR2_PACKAGE_NGINX_HTTP_GUNZIP_MODULE=y
BR2_PACKAGE_NGINX_HTTP_GZIP_STATIC_MODULE=y
BR2_PACKAGE_NGINX_HTTP_AUTH_REQUEST_MODULE=y
BR2_PACKAGE_NGINX_HTTP_RANDOM_INDEX_MODULE=y
BR2_PACKAGE_NGINX_HTTP_SECURE_LINK_MODULE=y
BR2_PACKAGE_NGINX_HTTP_DEGRADATION_MODULE=y
BR2_PACKAGE_NGINX_HTTP_SLICE_MODULE=y
BR2_PACKAGE_NGINX_HTTP_STUB_STATUS_MODULE=y
BR2_PACKAGE_NMAP=y
BR2_PACKAGE_NMAP_NCAT=y
BR2_PACKAGE_NMAP_NMAP=y
BR2_PACKAGE_NMAP_NPING=y
BR2_PACKAGE_NTP=y
BR2_PACKAGE_TCPDUMP=y
BR2_PACKAGE_WPA_SUPPLICANT=y
BR2_PACKAGE_WPA_SUPPLICANT_AP_SUPPORT=y
BR2_PACKAGE_WPA_SUPPLICANT_CLI=y
BR2_PACKAGE_WPA_SUPPLICANT_WPA_CLIENT_SO=y
BR2_PACKAGE_WPA_SUPPLICANT_PASSPHRASE=y
BR2_PACKAGE_WPAN_TOOLS=y
BR2_PACKAGE_BASH=y
BR2_PACKAGE_FILE=y
BR2_PACKAGE_HTOP=y
BR2_PACKAGE_KMOD_TOOLS=y
BR2_PACKAGE_UTIL_LINUX_BINARIES=y
BR2_PACKAGE_UTIL_LINUX_AGETTY=y
BR2_PACKAGE_UTIL_LINUX_CAL=y
BR2_PACKAGE_UTIL_LINUX_FSCK=y
BR2_PACKAGE_UTIL_LINUX_MOUNT=y
BR2_PACKAGE_UTIL_LINUX_RFKILL=y
BR2_PACKAGE_UTIL_LINUX_SULOGIN=y
BR2_PACKAGE_NANO=y
BR2_TARGET_ROOTFS_EXT2=y
BR2_TARGET_ROOTFS_EXT2_4=y
BR2_TARGET_ROOTFS_EXT2_SIZE="2048M"
BR2_TARGET_UBOOT=y
BR2_TARGET_UBOOT_BUILD_SYSTEM_KCONFIG=y
BR2_TARGET_UBOOT_CUSTOM_VERSION=y
BR2_TARGET_UBOOT_CUSTOM_VERSION_VALUE="2023.01"
BR2_TARGET_UBOOT_USE_CUSTOM_CONFIG=y
BR2_TARGET_UBOOT_CUSTOM_CONFIG_FILE="$(BR2_EXTERNAL_BLACKHAT_PATH)/configs/uboot-A33-OLinuXino_defconfig"
BR2_TARGET_UBOOT_NEEDS_DTC=y
BR2_TARGET_UBOOT_NEEDS_PYLIBFDT=y
BR2_TARGET_UBOOT_NEEDS_OPENSSL=y
BR2_TARGET_UBOOT_SPL=y
BR2_TARGET_UBOOT_SPL_NAME="u-boot-sunxi-with-spl.bin"
BR2_TARGET_UBOOT_CUSTOM_DTS_PATH="$(BR2_EXTERNAL_BLACKHAT_PATH)/board/uboot/flipper-blackhat-a33.dts"
BR2_PACKAGE_HOST_DOSFSTOOLS=y
BR2_PACKAGE_HOST_GENIMAGE=y
BR2_PACKAGE_HOST_MTOOLS=y
BR2_PACKAGE_HOST_UBOOT_TOOLS=y
BR2_PACKAGE_HOST_UBOOT_TOOLS_BOOT_SCRIPT=y
BR2_PACKAGE_HOST_UBOOT_TOOLS_BOOT_SCRIPT_SOURCE="$(BR2_EXTERNAL_BLACKHAT_PATH)/board/boot.cmd"
BR2_PACKAGE_BLACKHAT=y
BR2_PACKAGE_PYTHON_ROUTERSPLOIT=y
BR2_PACKAGE_PYTHON_NMAP=y
BR2_PACKAGE_PYTHON_PYWIFI=y
```

## configs/flipper_blackhat_defconfig
```kconfig
BR2_riscv=y
BR2_TOOLCHAIN_BUILDROOT_CXX=y
BR2_GLOBAL_PATCH_DIR="$(BR2_EXTERNAL_SIPEED_PATH)/patches"
BR2_TARGET_GENERIC_HOSTNAME="flipper-blackhat"
BR2_TARGET_GENERIC_ISSUE="Welcome to the Flipper Blackhat"
BR2_TARGET_GENERIC_ROOT_PASSWD="blackhat"
BR2_ROOTFS_OVERLAY="$(BR2_EXTERNAL_SIPEED_PATH)/rootfs_overlay/"
BR2_ROOTFS_POST_BUILD_SCRIPT="$(BR2_EXTERNAL_SIPEED_PATH)/genimage/post-build.sh"
BR2_ROOTFS_POST_IMAGE_SCRIPT="support/scripts/genimage.sh"
BR2_ROOTFS_POST_SCRIPT_ARGS="-c $(BR2_EXTERNAL_SIPEED_PATH)/genimage/genimage.cfg"
BR2_LINUX_KERNEL=y
BR2_LINUX_KERNEL_USE_CUSTOM_CONFIG=y
BR2_LINUX_KERNEL_CUSTOM_CONFIG_FILE="$(BR2_EXTERNAL_SIPEED_PATH)/configs/linux_nezha_defconfig"
BR2_LINUX_KERNEL_DTS_SUPPORT=y
BR2_LINUX_KERNEL_CUSTOM_DTS_PATH="$(BR2_EXTERNAL_SIPEED_PATH)/board/flipper-blackhat.dts"
BR2_LINUX_KERNEL_INSTALL_TARGET=y
BR2_PACKAGE_BUSYBOX_SHOW_OTHERS=y
BR2_PACKAGE_DOS2UNIX=y
BR2_PACKAGE_E2FSPROGS=y
BR2_PACKAGE_E2FSPROGS_RESIZE2FS=y
BR2_PACKAGE_LINUX_FIRMWARE=y
BR2_PACKAGE_LINUX_FIRMWARE_RTL_87XX=y
BR2_PACKAGE_LINUX_FIRMWARE_RTL_88XX=y
BR2_PACKAGE_LINUX_FIRMWARE_RTL_RTW88=y
BR2_PACKAGE_AIRCRACK_NG=y
BR2_PACKAGE_APACHE=y
BR2_PACKAGE_DHCPCD=y
BR2_PACKAGE_DNSMASQ=y
# BR2_PACKAGE_DNSMASQ_TFTP is not set
BR2_PACKAGE_DROPBEAR=y
BR2_PACKAGE_ETHTOOL=y
BR2_PACKAGE_GESFTPSERVER=y
BR2_PACKAGE_HOSTAPD=y
# BR2_PACKAGE_IFUPDOWN_SCRIPTS is not set
BR2_PACKAGE_IPTABLES=y
BR2_PACKAGE_IW=y
BR2_PACKAGE_IWD=y
BR2_PACKAGE_TINYSSH=y
BR2_PACKAGE_WPA_SUPPLICANT=y
BR2_PACKAGE_WPA_SUPPLICANT_AP_SUPPORT=y
BR2_PACKAGE_WPA_SUPPLICANT_CLI=y
BR2_PACKAGE_WPA_SUPPLICANT_WPA_CLIENT_SO=y
BR2_PACKAGE_WPA_SUPPLICANT_PASSPHRASE=y
BR2_PACKAGE_WPAN_TOOLS=y
BR2_PACKAGE_BASH=y
BR2_PACKAGE_KMOD=y
BR2_PACKAGE_KMOD_TOOLS=y
BR2_PACKAGE_UTIL_LINUX_BINARIES=y
BR2_TARGET_ROOTFS_EXT2=y
BR2_TARGET_ROOTFS_EXT2_4=y
BR2_TARGET_ROOTFS_EXT2_SIZE="256M"
# BR2_TARGET_ROOTFS_TAR is not set
BR2_TARGET_OPENSBI=y
BR2_TARGET_OPENSBI_CUSTOM_VERSION=y
BR2_TARGET_OPENSBI_CUSTOM_VERSION_VALUE="1.2"
BR2_TARGET_OPENSBI_PLAT="generic"
# BR2_TARGET_OPENSBI_INSTALL_JUMP_IMG is not set
BR2_TARGET_UBOOT=y
BR2_TARGET_UBOOT_BUILD_SYSTEM_KCONFIG=y
BR2_TARGET_UBOOT_CUSTOM_TARBALL=y
BR2_TARGET_UBOOT_CUSTOM_TARBALL_LOCATION="$(call github,smaeul,u-boot,528ae9bc6c55edd3ffe642734b4132a8246ea777)/uboot-528ae9bc6c55edd3ffe642734b4132a8246ea777.tar.gz"
BR2_TARGET_UBOOT_BOARD_DEFCONFIG="lichee_rv_dock"
BR2_TARGET_UBOOT_NEEDS_DTC=y
BR2_TARGET_UBOOT_NEEDS_PYLIBFDT=y
BR2_TARGET_UBOOT_NEEDS_OPENSSL=y
BR2_TARGET_UBOOT_NEEDS_OPENSBI=y
# BR2_TARGET_UBOOT_FORMAT_BIN is not set
BR2_TARGET_UBOOT_FORMAT_CUSTOM=y
BR2_TARGET_UBOOT_FORMAT_CUSTOM_NAME="u-boot-sunxi-with-spl.bin"
BR2_PACKAGE_HOST_GENIMAGE=y
BR2_PACKAGE_BLACKHAT=y
```

## configs/uboot-A33-OLinuXino_defconfig
```kconfig
CONFIG_ARM=y
CONFIG_ARCH_SUNXI=y
CONFIG_DEFAULT_DEVICE_TREE="flipper-blackhat-a33"
CONFIG_SPL=y
CONFIG_MACH_SUN8I_A33=y
CONFIG_DRAM_CLK=432
CONFIG_DRAM_ZQ=15291
CONFIG_DRAM_ODT_EN=y
CONFIG_MMC0_CD_PIN="PB4"
CONFIG_USB0_VBUS_PIN="AXP0-VBUS-ENABLE"
CONFIG_USB0_VBUS_DET="AXP0-VBUS-DETECT"
CONFIG_USB0_ID_DET="PB3"
CONFIG_VIDEO_LCD_MODE="x:800,y:480,depth:18,pclk_khz:33000,le:16,ri:209,up:22,lo:22,hs:30,vs:1,sync:3,vmode:0"
CONFIG_VIDEO_LCD_DCLK_PHASE=0
CONFIG_VIDEO_LCD_BL_EN="PB2"
CONFIG_VIDEO_LCD_BL_PWM="PH0"
# CONFIG_SYS_MALLOC_CLEAR_ON_INIT is not set
CONFIG_BOOTDELAY=-2
CONFIG_DM_PMIC=y
CONFIG_PMIC_AXP=y
CONFIG_SUNXI_NO_PMIC=y
CONFIG_USB_MUSB_HOST=y
```

## package/bjorn/Config.in
```kconfig
config BR2_PACKAGE_BJORN
    bool "bjorn"
    help
        Bjorn is a Tamagotchi like sophisticated, autonomous network scanning, vulnerability assessment, and offensive security tool

    select BR2_PACKAGE_LSOF
    select BR2_PACKAGE_PYTHON_NETIFACES
    select BR2_PACKAGE_PYTHON_PIP
    select BR2_PACKAGE_PYTHON_PYMYSQL
    select BR2_PACKAGE_PYTHON_PYSMB
    select BR2_PACKAGE_PYTHON_SMBPROTOCOL
    select BR2_PACKAGE_PYTHON_SQLALCHEMY
    select BR2_PACKAGE_PYTHON_LEGACY_CGI
    select BR2_PACKAGE_GNUTLS_OPENSSL
    select BR2_PACKAGE_WGET
```

## package/blackhat/Config.in
```kconfig
config BR2_PACKAGE_BLACKHAT
    bool "flipper-blackhat"
    help
        Script for working with the flipper blackhat.
```

## package/opennds/Config.in
```kconfig
config BR2_PACKAGE_OPENNDS
    bool "opennds"
    help
        opennds

    select BR2_PACKAGE_NFTABLES
    select BR2_PACKAGE_LIBMICROHTTPD
```

## package/python-getmac/Config.in
```kconfig
config BR2_PACKAGE_PYTHON_GETMAC
    bool "python-getmac"
    help
        Pure-Python package to get the MAC address of network interfaces and hosts on the local network.
```

## package/python-nmap/Config.in
```kconfig
config BR2_PACKAGE_PYTHON_NMAP
    bool "python-nmap"
    help
        A python 3 library which helps in using nmap port scanner.

    select BR2_PACKAGE_PYTHON_SIMPLEJSON
```

## package/python-pandas/Config.in
```kconfig
config BR2_PACKAGE_PYTHON_PANDAS_ARCH_SUPPORTS
	bool
	# Numpy has some CPU specific code
	default y if BR2_arc
	default y if BR2_aarch64
	default y if BR2_aarch64_be
	default y if BR2_arm
	default y if BR2_armeb
	default y if BR2_i386
	default y if BR2_m68k
	default y if BR2_mips
	default y if BR2_mipsel
	default y if BR2_or1k
	default y if BR2_powerpc
	default y if BR2_powerpc64
	default y if BR2_powerpc64le
	default y if BR2_riscv
	default y if BR2_sh
	default y if BR2_sparc
	default y if BR2_sparc64
	default y if BR2_x86_64

config BR2_PACKAGE_PYTHON_PANDAS
    bool "python-pandas"
    select BR2_PACKAGE_PYTHON_DATEUTIL
    select BR2_PACKAGE_PYTHON_PYTZ
    select BR2_PACKAGE_PYTHON_NUMPY
    select BR2_PACKAGE_BZIP2
    select BR2_PACKAGE_HOST_PYTHON_MESON_PYTHON
    select BR2_PACKAGE_HOST_PYTHON_VERSIONEER
    select BR2_PACKAGE_HOST_PYTHON_CYTHON
    select BR2_PACKAGE_HOST_PYTHON_NUMPY

    help
        Powerful data structures for data analysis, time series, and statistics.


comment "python-pandas needs a glibc or musl toolchain w/ C++, gcc >= 9"
	depends on BR2_PACKAGE_PYTHON_PANDAS_ARCH_SUPPORTS
	depends on !BR2_INSTALL_LIBSTDCPP || \
		!BR2_TOOLCHAIN_GCC_AT_LEAST_9 || \
		!(BR2_TOOLCHAIN_USES_GLIBC || BR2_TOOLCHAIN_USES_MUSL)
```

## package/python-pycryptodome/Config.in
```kconfig
config BR2_PACKAGE_PYTHON_PYCRYPTODOME
    bool "python-pycryptodome"
    help
        PyCryptodome is a self-contained Python package of low-level cryptographic primitives.
```

## package/python-pywifi/Config.in
```kconfig
config BR2_PACKAGE_PYTHON_PYWIFI
    bool "python-pywifi"
    help
        Pywifi provides a cross-platform Python module for manipulating wireless interfaces.
```

## package/python-rich/Config.in
```kconfig
config BR2_PACKAGE_PYTHON_RICH
    bool "python-rich"
    help
        Rich is a Python library for rich text and beautiful formatting in the terminal.

   select BR2_PACKAGE_PYTHON_PYGMENTS
```

## package/python-routersploit/Config.in
```kconfig
config BR2_PACKAGE_PYTHON_ROUTERSPLOIT
    bool "python-routersploit"
    help
        Exploitation Framework for Embedded Devices

    select BR2_PACKAGE_PYTHON_REQUESTS
    select BR2_PACKAGE_PYTHON_PARAMIKO
    select BR2_PACKAGE_PYTHON_PYSNMP
    select BR2_PACKAGE_PYTHON_PYCRYPTODOME
    select BR2_PACKAGE_PYTHON_TELNETLIB3
```

## package/python-version/Config.in
```kconfig
config BR2_PACKAGE_PYTHON_VERSION
    bool "python-version"
    help
        This package provides a basic python version checking utility.
```

## package/python-wifite2/Config.in
```kconfig
config BR2_PACKAGE_PYTHON_WIFITE2
    bool "python-wifite2"
    help
        Python script for auditing wireless networks.

    select BR2_PACKAGE_PYTHON_CHARDET
    select BR2_PACKAGE_PYTHON_REQUESTS
    select BR2_PACKAGE_PYTHON_RICH
    select BR2_PACKAGE_PYTHON_SCAPY
    select BR2_PACKAGE_PYTHON_VERSION
```
